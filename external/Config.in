## external/Config.in
```kconfig
#
# My external Buildroot configuration
#

menu "External buildroot options"

config BR2_EXTERNAL_MY_EXTERNAL
    bool "Enable my external"
    help
      This enables my external Buildroot packages and settings.

endmenu
```

## external/configs/rpi_cm5_plc_defconfig
```kconfig
BR2_aarch64=y
BR2_cortex_a76=y
BR2_TOOLCHAIN_BUILDROOT_UCLIBC=y
BR2_PACKAGE_HOST_LINUX_HEADERS_CUSTOM_6_6=y
BR2_ROOTFS_OVERLAY="../board/raspberrypi/cm5/rootfs_overlay"
BR2_ROOTFS_POST_IMAGE_SCRIPT="board/raspberrypi/post-image.sh"
BR2_ROOTFS_POST_SCRIPT_ARGS="--add-pi5-miniuart-bt-overlay -c board/raspberrypi/genimage-raspberrypi5.cfg"
BR2_LINUX_KERNEL=y
BR2_LINUX_KERNEL_CUSTOM_GIT=y
BR2_LINUX_KERNEL_CUSTOM_REPO_URL="https://github.com/raspberrypi/linux.git"
BR2_LINUX_KERNEL_CUSTOM_REPO_VERSION="rpi-6.6.y"
BR2_LINUX_KERNEL_CUSTOM_REPO_GIT_SUBMODULES=y
BR2_LINUX_KERNEL_DEFCONFIG="bcm2712"
BR2_LINUX_KERNEL_DTS_SUPPORT=y
BR2_LINUX_KERNEL_DTB_IS_SELF_BUILT=y
BR2_LINUX_KERNEL_INTREE_DTS_NAME="broadcom/bcm2712-rpi-cm5-cm5io"
BR2_LINUX_KERNEL_NEEDS_HOST_OPENSSL=y
BR2_LINUX_KERNEL_NEEDS_HOST_LIBELF=y
BR2_PACKAGE_BUSYBOX_SHOW_OTHERS=y
BR2_PACKAGE_RPI_FIRMWARE=y
BR2_PACKAGE_EVTEST=y
BR2_PACKAGE_KBD=y
BR2_TARGET_ROOTFS_EXT2=y
BR2_TARGET_ROOTFS_EXT2_4=y
BR2_PACKAGE_HOST_DOSFSTOOLS=y
BR2_PACKAGE_HOST_GENIMAGE=y
BR2_PACKAGE_HOST_IMAGEMAGICK=y
BR2_PACKAGE_HOST_IMAGEMAGICK_SVG=y
BR2_PACKAGE_HOST_MTOOLS=y
```

## external/rpi_cm5_plc_defconfig
```kconfig
# Architecture
BR2_aarch64=y
BR2_cortex_a76=y

# Toolchain
BR2_TOOLCHAIN_BUILDROOT=y
BR2_TOOLCHAIN_BUILDROOT_GLIBC=y


# ===== Linux Kernel =====
BR2_LINUX_KERNEL=y
BR2_LINUX_KERNEL_CUSTOM_GIT=y
BR2_LINUX_KERNEL_CUSTOM_GIT_REPO_URL="../external/linux-src/linux"
BR2_LINUX_KERNEL_CUSTOM_GIT_VERSION="HEAD"

# Verwende Raspberry Pi bcm2712 defconfig
BR2_LINUX_KERNEL_DEFCONFIG="bcm2712"

# DTS
BR2_LINUX_KERNEL_DTS_SUPPORT=y
BR2_LINUX_KERNEL_INTREE_DTS_NAME="../external/linux-src/linux/arch/arm64/boot/dts/broadcom/linux/bcm2712-rpi-5-b"




# Kernel headers = Kernelversion
BR2_KERNEL_HEADERS_AS_KERNEL=y


# OPTIONAL:
# Eigene Kernel-Konfiguration anwenden
BR2_LINUX_KERNEL_USE_CUSTOM_CONFIG=y
BR2_LINUX_KERNEL_CUSTOM_CONFIG_FILE="../board/raspberrypi/cm5/linux.config"


# ===== Raspberry Pi Firmware =====
BR2_PACKAGE_RPI_FIRMWARE=y


# ===== Rootfs overlay =====
BR2_ROOTFS_OVERLAY="../board/raspberrypi/cm5/rootfs_overlay"


# ===== Tools =====
BR2_PACKAGE_BUSYBOX_SHOW_OTHERS=y
BR2_PACKAGE_KBD=y
BR2_PACKAGE_EVTEST=y


# ===== Python =====
BR2_PACKAGE_PYTHON3=y
```
